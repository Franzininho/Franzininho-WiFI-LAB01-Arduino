/*
  Franzininho WiFoi LAB01 - TEST
  
  Descrição: Este é o programa de autoteste do Franzininho WiFi LAB01 gravado em Fábrica.
  Ele realiza leituras do sensor DHT11, LDR e dos botões, além de acender LEDs e emitir sons no buzzer.
  O programa também exibe as leituras no display OLED SSD1306.

  Autor: Fabio Souza
  Data: 30/08/2023
*/

// Bibliotecas necessárias
#include <Wire.h>
#include <Adafruit_GFX.h>
#include <Adafruit_SSD1306.h>
#include <DHT.h>

// Definições para o buzzer
// Se o buzzer não tiver um oscilador, defina BUZZER_SEM_OSCILADOR como 1 
// Se o buzzer tiver um oscilador, comente a linha abaixo
#define BUZZER_SEM_OSCILADOR 1

#define SCREEN_WIDTH 128 // Largura da tela OLED
#define SCREEN_HEIGHT 64 // Altura da tela OLED

// Definição do endereço I2C do display OLED
#define OLED_RESET -1
Adafruit_SSD1306 display(SCREEN_WIDTH, SCREEN_HEIGHT, &Wire, OLED_RESET);

const int dhtPin = 15;  // Pino de conexão com o sensor DHT11
const int ldrPin = 1;   // Pino do LDR

const int ledPins[] = {14, 13, 12, 21,33}; // Pinos dos LEDs Vermelho, Verde e Azul
const int buzzerPin = 17;           // Pino do Buzzer

const int buttonPin[] = {7, 6, 5, 4, 3, 2}; // Pinos dos Botões 1 a 6

unsigned long debounceDelay = 50; // Atraso para evitar o efeito de debounce
unsigned long lastDebounceTime[] = {0, 0, 0,0, 0, 0}; // Último tempo de debounce para cada botão

int buttonState[] = {HIGH, HIGH, HIGH, HIGH, HIGH, HIGH};   // Estado atual de cada botão
int lastButtonState[] = {HIGH, HIGH, HIGH, HIGH, HIGH, HIGH}; // Último estado de cada botão

long int lightLevel[32];  // Array para armazenar os valores do LDR
int j = 0;                // Contador para os LEDs
int indice_light = 0;     // Índice para o array de luz

const long eventTime_LEDS = 1000; //in ms
const long eventTime_DISPLAY = 500; //in ms

// Variáveis para controle de tempo
unsigned long previousTime_LEDS = 0;
unsigned long previousTime_DISPLAY = 0;


// Definições para o Display OLED
#define imageWidth 128  // Largura da imagem do logo
#define imageHeight 64  // Altura da imagem do logo

// Logo da Franzininho
const unsigned char franzininho_logo_128x64 [] PROGMEM = {
  0x00, 0x00, 0x00, 0x00, 0x00, 0x00, 0x00, 0x00, 0x00, 0x00, 0x00, 0x00, 0x00, 0x00, 0x00, 0x00, 
  0x00, 0x00, 0x00, 0x00, 0x00, 0x00, 0x00, 0x00, 0x00, 0x00, 0x00, 0x00, 0x00, 0x00, 0x00, 0x00, 
  0x00, 0x00, 0x00, 0x00, 0x00, 0x00, 0x00, 0x00, 0x00, 0x00, 0x00, 0x00, 0x00, 0x00, 0x00, 0x00, 
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  0x00, 0x00, 0x00, 0x00, 0x00, 0x00, 0x00, 0x00, 0x00, 0x00, 0x00, 0x00, 0x00, 0x00, 0x00, 0x00
};

// Inicializa o sensor DHT11
DHT dht(dhtPin, DHT11);

void beep() {

  // Emite um beep curto no buzzer
  #ifdef BUZZER_SEM_OSCILADOR
  digitalWrite(buzzerPin, HIGH); // Liga o buzzer
  #else
  tone(buzzerPin, 440); // Emite um tom de 440 Hz no buzzer
  #endif
  delay(100); // Mantém o buzzer ligado por 100 ms

  // Desliga o buzzer após o beep
  #ifdef BUZZER_SEM_OSCILADOR
  digitalWrite(buzzerPin, LOW); // Desliga o buzzer
  #else
  noTone(buzzerPin);    // Para o som do buzzer
  #endif
}

void setup() {
  Serial.begin(115200);

  // Inicializa o display OLED
  display.begin(SSD1306_SWITCHCAPVCC, 0x3C);
  display.display(); // Inicializa o display com o buffer atual

  dht.begin(); // Inicializa o sensor DHT11

  for (int i = 0; i < 5; i++) {
    pinMode(ledPins[i], OUTPUT); // Configura os pinos dos LEDs como saída
  }

  pinMode(buzzerPin, OUTPUT); // Configura o pino do buzzer como saída

  for (int i = 0; i < 6; i++) {
    pinMode(buttonPin[i], INPUT_PULLUP); // Configura os pinos dos botões como entrada com pull-up
  }

  beep(); // Emite um beep curto para indicar que o setup foi iniciado

  // Mostra o logo da Franzininho como splash screen
  display.clearDisplay();
  display.drawBitmap(0, 0, franzininho_logo_128x64, imageWidth, imageWidth, WHITE);
  display.display();
  delay(2000); // Espera 2 segundos
}

void loop() {

  //Leitura de teclas
  for (int i = 0; i < 6; i++) {
    int reading = digitalRead(buttonPin[i]); // Lê o estado do botão

    if (reading != lastButtonState[i]) {
      lastDebounceTime[i] = millis(); // Atualiza o tempo de debounce
    }

    if ((millis() - lastDebounceTime[i]) > debounceDelay) {
      if (reading != buttonState[i]) {
        buttonState[i] = reading; // Atualiza o estado do botão
    
        if (buttonState[i] == LOW) {
          beep(); // Emite um beep curto
        }
      }
    }
    lastButtonState[i] = reading; // Atualiza o último estado do botão
  }

  lightLevel[indice_light] = analogRead(ldrPin);       // Lê o valor do LDR
  indice_light++;
  if(indice_light == 32)indice_light=0;

  unsigned long currentTime = millis();

  if ( currentTime - previousTime_LEDS >= eventTime_LEDS) 
  {
      // Desliga todos os LEDs'
      digitalWrite(14,LOW);
      digitalWrite(13,LOW);
      digitalWrite(12,LOW);
      digitalWrite(21,LOW);
      digitalWrite(33,LOW);
      
      // Acende o LED correspondente ao contador j
      switch(j){
        case 0:
        digitalWrite(14,HIGH);
        break;
        case 1:
        digitalWrite(13,HIGH);
        break;
        case 2:
        digitalWrite(12,HIGH);
        break;
        case 3:
        digitalWrite(21,HIGH);
        break;
        case 4:
        digitalWrite(33,HIGH);
        break;
      } 
      j++;
      if(j>=5) j=0;   
      
      //atualiza timer para o próximo evento
      previousTime_LEDS = currentTime;
    }

  currentTime = millis();
  // Verifica se é hora de atualizar o display
  if ( currentTime - previousTime_DISPLAY >= eventTime_DISPLAY) {
  
    long int lightValue = 0;
    //leitura LDR 
    for(int i = 0;i<32;i++){
      lightValue += lightLevel[i];  // Soma os valores lidos do LDR
    }
    lightValue /=32;  // Calcula a média dos valores lidos do LDR

    // Converte o valor do LDR para uma escala de 0 a 100
    lightValue = map(lightValue, 0, 8192, 0, 100);
    
    //Leitura DHT
    float temperature = dht.readTemperature(); // Lê a temperatura em graus Celsius
    float humidity = dht.readHumidity();       // Lê a umidade relativa do ar
  
    //display
    display.clearDisplay(); // Limpa a tela

    display.setTextSize(1); // Tamanho do texto
    display.setTextColor(WHITE); // Cor do texto
    display.setCursor(0, 0); // Posição do cursor

    display.print("T: ");
    display.print(temperature);
    display.println(" C");

    display.print("U: ");
    display.print(humidity);
    display.println(" %");

    display.print("L: ");
    display.println(lightValue);
    
    display.println("");
    display.print(" BT1: ");
    display.print(buttonState[0]);
    display.print("  BT2: ");
    display.println(buttonState[1]);
    display.print(" BT3: ");
    display.print(buttonState[2]);
    display.print("  BT4: ");
    display.println(buttonState[3]);
    display.print(" BT5: ");
    display.print(buttonState[4]);
    display.print("  BT6: ");
    display.print(buttonState[5]);
  
    display.display(); // Atualiza o display

    Serial.println("Teste da Franzininho WiFi LAB01 - Comunicação Serial Ok");
      
      // Atualiza o tempo para o próximo evento de exibição
      previousTime_DISPLAY = currentTime;
  }
}
